## firmware/node/main/Kconfig.projbuild
```kconfig
menu "WCSI node configuration"

    config WIFICSI_PROTOCOL_SELF_TEST
        bool "Run WCSI protocol and queue startup self-tests"
        default y

    config WCSI_WIFI_SSID
        string "Wi-Fi SSID (set only in the ignored generated sdkconfig)"
        default ""

    config WCSI_WIFI_PASSWORD
        string "Wi-Fi password (set only in the ignored generated sdkconfig)"
        default ""

    config WCSI_SERVER_ADDRESS
        string "Sensing server IPv4 address"
        default "10.204.75.168"

    config WCSI_SERVER_PORT
        int "Sensing server UDP port"
        range 1 65535
        default 5500

    config WCSI_LOCAL_PORT
        int "Node command UDP port"
        range 1 65535
        default 5501

    config WCSI_QUEUE_CAPACITY
        int "Telemetry queue capacity"
        range 8 2048
        default 512

    config WCSI_HEARTBEAT_PERIOD_MS
        int "Heartbeat period (ms)"
        range 100 60000
        default 1000

    config WCSI_STATE_PERIOD_MS
        int "Sensing state period (ms)"
        range 100 60000
        default 1000

    config WCSI_HELLO_PERIOD_MS
        int "HELLO period (ms)"
        range 1000 300000
        default 30000

    config WCSI_RECONNECT_SELF_TEST
        bool "Enable reconnect fault-injection self-test"
        default n

    config WCSI_RECONNECT_SELF_TEST_DELAY_MS
        int "Reconnect fault-injection delay after first IP (ms)"
        depends on WCSI_RECONNECT_SELF_TEST
        range 1000 60000
        default 5000

    config WCSI_SENSING_INIT_FAULT_SELF_TEST
        bool "Fail the first sensing installation for recovery self-test"
        depends on WIFICSI_PROTOCOL_SELF_TEST
        default n

    config WCSI_TX_ORDER_FAULT_SELF_TEST
        bool "Delay one command ACK after sequence allocation"
        depends on WIFICSI_PROTOCOL_SELF_TEST
        default n

endmenu
```

## firmware/node/sdkconfig.defaults
```kconfig
CONFIG_ESPTOOLPY_FLASHSIZE_8MB=y
CONFIG_PARTITION_TABLE_CUSTOM=y
CONFIG_PARTITION_TABLE_CUSTOM_FILENAME="partitions.csv"
CONFIG_COMPILER_OPTIMIZATION_SIZE=y
CONFIG_LOG_DEFAULT_LEVEL_INFO=y
CONFIG_SPIRAM=y
CONFIG_SPIRAM_MODE_OCT=y
CONFIG_SPIRAM_SPEED_80M=y
CONFIG_SPIRAM_USE_MALLOC=y
```
